## boards/shields/uollp/Kconfig.defconfig
```kconfig
if SHIELD_UOLLP || SHIELD_UOLLP_LEFT

config ZMK_KEYBOARD_NAME
    default "uollp"

endif

if SHIELD_UOLLP_LEFT || SHIELD_UOLLP_RIGHT

config ZMK_SPLIT
    default y

endif

if SHIELD_UOLLP_LEFT

config ZMK_SPLIT_ROLE_CENTRAL
    default y

endif
```

## boards/shields/uollp/Kconfig.shield
```kconfig
config SHIELD_UOLLP
    def_bool $(shields_list_contains,uollp)

config SHIELD_UOLLP_LEFT
    def_bool $(shields_list_contains,uollp_left)

config SHIELD_UOLLP_RIGHT
    def_bool $(shields_list_contains,uollp_right)
```
